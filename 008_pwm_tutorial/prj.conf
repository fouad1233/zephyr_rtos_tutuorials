## CMakeLists.txt
```
cmake_minimum_required(VERSION 3.22)
set(CMAKE_EXPORT_COMPILE_COMMANDS ON)
set(BOARD stg_800 )

find_package(Zephyr REQUIRED HINTS $ENV{ZEPHYR_BASE})
project(008_pwm_tutoria)

target_sources(app PRIVATE src/main.c)
```

## prj.conf
```kconfig
CONFIG_MAIN_THREAD_PRIORITY=0
CONFIG_MAIN_STACK_SIZE=1024
CONFIG_SYSTEM_WORKQUEUE_STACK_SIZE=1024
CONFIG_LOG=y
CONFIG_SERIAL=y
CONFIG_GPIO=y

CONFIG_PWM=y
CONFIG_PWM_STM32=y


CONFIG_PRINTK=y
CONFIG_LOG_PRINTK=y

CONFIG_BOOTLOADER_MCUBOOT=y

CONFIG_MCUBOOT_SIGNATURE_KEY_FILE="bootloader/mcuboot/mykey-ecdsa-p256.pem"
CONFIG_MCUBOOT_ENCRYPTION_KEY_FILE="bootloader/mcuboot/mykey-ecdsa-p256.pem"



# Add other necessary configurations
# ...
```

## src/main.c
```c
#include <zephyr/kernel.h>
#include <zephyr/devicetree.h>
#include <zephyr/drivers/pwm.h>
//#include <zephyr/logging/log.h>
#include <zephyr/drivers/gpio.h>

//LOG_MODULE_REGISTER(pwm_sample, LOG_LEVEL_INF);

#define PWM_CHANNEL 1
#define LED0_NODE DT_NODELABEL(green_led)


static const struct gpio_dt_spec led = GPIO_DT_SPEC_GET(LED0_NODE, gpios);
static const struct pwm_dt_spec green_pwm_led = PWM_DT_SPEC_GET(DT_NODELABEL(green_pwm_led));
int ret;
int main(void)
{
    gpio_pin_configure_dt(&led, GPIO_OUTPUT_ACTIVE);
    if (!device_is_ready(green_pwm_led.dev)) {
        printk("PWM device  is not ready\n");
        return -ENODEV;
    }

    
    while (true)
    {
        ret = pwm_set_pulse_dt(&green_pwm_led,0);
        gpio_pin_toggle_dt(&led);
        k_sleep(K_MSEC(1000));
        ret = pwm_set_pulse_dt(&green_pwm_led,10000);
        gpio_pin_toggle_dt(&led);
        k_sleep(K_MSEC(1000));
    }
    
    return 0;
}
```
