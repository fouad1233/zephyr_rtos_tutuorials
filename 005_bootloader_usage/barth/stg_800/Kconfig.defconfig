## 005_bootloader_usage/barth/stg_800/Kconfig.defconfig
```kconfig
# STG-800 PLC board by BARTH

# Copyright (c) 2017 Bobby Noelte
# SPDX-License-Identifier: Apache-2.0

if BOARD_STG_800

config SPI_STM32_INTERRUPT
	default y
	depends on SPI

endif # BOARD_STG_800
```
